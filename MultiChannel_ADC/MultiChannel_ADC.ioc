# file: MultiChannel_ADC.ioc
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Mcu.Family=STM32F4
Mcu.Name=STM32F401R(B-C)Tx
Mcu.Package=LQFP64
NVIC.PriorityGroup=NVIC_PRIORITYGROUP_4
ProjectManager.HeapSize=0x200
ProjectManager.StackSize=0x400
ProjectManager.TargetToolchain=STM32CubeIDE
RCC.48MHZClocksFreq_Value=42000000
RCC.AHBFreq_Value=84000000
RCC.APB1CLKDivider=RCC_HCLK_DIV2
RCC.APB1Freq_Value=42000000
RCC.APB1TimFreq_Value=84000000
RCC.APB2Freq_Value=84000000
RCC.APB2TimFreq_Value=84000000
RCC.CortexFreq_Value=84000000
RCC.HCLKFreq_Value=84000000
RCC.HSE_VALUE=25000000
RCC.HSI_VALUE=16000000
RCC.LSE_VALUE=32768
RCC.PLLM=8
RCC.PLLN=84
RCC.SYSCLKFreq_VALUE=84000000
RCC.SYSCLKSource=RCC_SYSCLKSOURCE_PLLCLK
RCC.VCOOutputFreq_Value=168000000
board=custom

// file: Core/Src/main.c
/* USER CODE BEGIN Header */
/**
  ******************************************************************************
  * @file           : main.c
  * @brief          : Main program body
  ******************************************************************************
  * @attention
  *
  * Copyright (c) 2025 STMicroelectronics.
  * All rights reserved.
  *
  * This software is licensed under terms that can be found in the LICENSE file
  * in the root directory of this software component.
  * If no LICENSE file comes with this software, it is provided AS-IS.
  *
  ******************************************************************************
  */
/* USER CODE END Header */
#include "main.h"

/* USER CODE BEGIN PV */
uint16_t pot_value;
float pot_voltage;

uint16_t lm35_value;
float lm35_voltage;
float temperatureC;

uint16_t ADC_VAL[2] = {0,0};
/* USER CODE END PV */

void SystemClock_Config(void);
/* USER CODE BEGIN PFP */
void ADC_Disable (void);
uint16_t ADC_GetVal (void);
void ADC_WaitForConv (void);
void ADC_Start (int channel);
void ADC_Enable (void);
void ADC_Multi_Init(void);
/* USER CODE END PFP */

int main(void)
{

  /* MCU Configuration--------------------------------------------------------*/

  /* Reset of all peripherals, Initializes the Flash interface and the Systick. */
  HAL_Init();

  /* Configure the system clock */
  SystemClock_Config();

  /* Initialize all configured peripherals */
  /* USER CODE BEGIN 2 */
	  ADC_Multi_Init();

	  ADC_Enable ();
  /* USER CODE END 2 */

  /* Infinite loop */
  while (1)
  {

    /* USER CODE BEGIN 3 */
	ADC_Start (0);
	ADC_WaitForConv ();
	ADC_VAL[0] = ADC_GetVal();

	ADC_Start (1);
	ADC_WaitForConv ();
	ADC_VAL[1] = ADC_GetVal();

	pot_voltage = ADC_VAL[0] * (3.3/4095.0);
	lm35_voltage = ADC_VAL[1] * (3.3/4095.0);
	temperatureC = (lm35_voltage) * 100 ;

	HAL_Delay(10);

  }
  /* USER CODE END 3 */
}

void SystemClock_Config(void)
{
  RCC_OscInitTypeDef RCC_OscInitStruct = {0};
  RCC_ClkInitTypeDef RCC_ClkInitStruct = {0};

  /** Configure the main internal regulator output voltage
  */
  __HAL_RCC_PWR_CLK_ENABLE();
  __HAL_PWR_VOLTAGESCALING_CONFIG(PWR_REGULATOR_VOLTAGE_SCALE2);

  /** Initializes the RCC Oscillators according to the specified parameters
  * in the RCC_OscInitTypeDef structure.
  */
  RCC_OscInitStruct.OscillatorType = RCC_OSCILLATORTYPE_HSI;
  RCC_OscInitStruct.HSIState = RCC_HSI_ON;
  RCC_OscInitStruct.HSICalibrationValue = RCC_HSICALIBRATION_DEFAULT;
  RCC_OscInitStruct.PLL.PLLState = RCC_PLL_ON;
  RCC_OscInitStruct.PLL.PLLSource = RCC_PLLSOURCE_HSI;
  RCC_OscInitStruct.PLL.PLLM = 8;
  RCC_OscInitStruct.PLL.PLLN = 84;
  RCC_OscInitStruct.PLL.PLLP = RCC_PLLP_DIV2;
  RCC_OscInitStruct.PLL.PLLQ = 4;
  if (HAL_RCC_OscConfig(&RCC_OscInitStruct) != HAL_OK)
  {
    Error_Handler();
  }

  /** Initializes the CPU, AHB and APB buses clocks
  */
  RCC_ClkInitStruct.ClockType = RCC_CLOCKTYPE_HCLK|RCC_CLOCKTYPE_SYSCLK
                              |RCC_CLOCKTYPE_PCLK1|RCC_CLOCKTYPE_PCLK2;
  RCC_ClkInitStruct.SYSCLKSource = RCC_SYSCLKSOURCE_PLLCLK;
  RCC_ClkInitStruct.AHBCLKDivider = RCC_SYSCLK_DIV1;
  RCC_ClkInitStruct.APB1CLKDivider = RCC_HCLK_DIV2;
  RCC_ClkInitStruct.APB2CLKDivider = RCC_HCLK_DIV1;

  if (HAL_RCC_ClockConfig(&RCC_ClkInitStruct, FLASH_LATENCY_2) != HAL_OK)
  {
    Error_Handler();
  }
}

/* USER CODE BEGIN 4 */

void ADC_Enable (void)
{
	ADC1->CR2 |= 1<<0;   // ADON =1 enable ADC1
	HAL_Delay(1);
}

void ADC_Start (int channel)
{

	ADC1->SQR3 = 0;
	ADC1->SQR3 |= (channel<<0);    // conversion in regular sequence

	ADC1->SR = 0;        		   // clear the status register

	ADC1->CR2 |= (1<<30);    	   // start the conversion
}

void ADC_WaitForConv (void)
{

	while (!(ADC1->SR & (1<<1)));  // wait for EOC flag to set
}

uint16_t ADC_GetVal (void)
{
	return ADC1->DR;  // Read the Data Register
}

void ADC_Disable (void)
{
	ADC1->CR2 &= ~(1<<0);  // Disable ADC
}

void ADC_Multi_Init(void)
{
    //Enable the clock for GPIOA and ADC1
    RCC->AHB1ENR |= RCC_AHB1ENR_GPIOAEN;   // Enable GPIOA clock
    RCC->APB2ENR |= RCC_APB2ENR_ADC1EN;    // Enable ADC1 clock

    //Configure PA0 as analog mode
    GPIOA->MODER |= (3U << (0 * 2));       // Set PA0 to analog mode (MODER[1:0] = 11)
    GPIOA->PUPDR &= ~(3U << (0 * 2));      // No pull-up, pull-down (PUPDR[1:0] = 00)

    //Configure PA1 as analog mode
    GPIOA->MODER |= (3U << (1 * 2));       // Set PA0 to analog mode (MODER[1:0] = 11)
    GPIOA->PUPDR &= ~(3U << (1 * 2));      // No pull-up, pull-down (PUPDR[1:0] = 00)

    //Configure the ADC1
    ADC1->CR2 = 0;                         // Ensure ADC is disabled before configuration

    ADC1->CR1 = 0;                         // Use default resolution (12-bit), single conversion mode

	ADC1->CR2 |= (1<<10);    			   // EOC after each conversion

    ADC1->SQR1 |= (1 << 20);               // two conversions

    ADC1->SQR3 |= (0 << (0 * 4));          // First conversion in the sequence is Channel 0 (PA0)
    ADC1->SQR3 |= (1 << (1 * 4));          // First conversion in the sequence is Channel 0 (PA0)

	ADC->CCR |= 1<<16;  		           // PCLK2 divide by 4

    //Set ADC1 sample time for Channel 0
    ADC1->SMPR2 |= (7U << (0 * 3));  // Maximum sampling time (480 cycles) - Channel 0 (POT)

    // Configure sample time for Channel 1 (LM35)
    ADC1->SMPR2 |= (7U << (1 * 3));  // Maximum sampling time (480 cycles)  - Channel 1 (LM35)

    //Enable ADC1
    ADC1->CR2 |= ADC_CR2_ADON;             // Enable the ADC
}
/* USER CODE END 4 */

void Error_Handler(void)
{
  __disable_irq();
  while (1)
  {
  }
}
