# file: MultiADC_CONT.ioc
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Mcu.Family=STM32F4
Mcu.Name=STM32F401R(B-C)Tx
Mcu.Package=LQFP64
NVIC.PriorityGroup=NVIC_PRIORITYGROUP_4
ProjectManager.HeapSize=0x200
ProjectManager.StackSize=0x400
ProjectManager.TargetToolchain=STM32CubeIDE
RCC.AHBFreq_Value=16000000
RCC.APB1Freq_Value=16000000
RCC.APB2Freq_Value=16000000
RCC.CortexFreq_Value=16000000
RCC.HSE_VALUE=25000000
RCC.HSI_VALUE=16000000
RCC.LSE_VALUE=32768
RCC.SYSCLKFreq_VALUE=16000000
RCC.VCOOutputFreq_Value=192000000
board=custom

// file: Core/Src/main.c
/* USER CODE BEGIN Header */
/**
  ******************************************************************************
  * @file           : main.c
  * @brief          : Main program body
  ******************************************************************************
  * @attention
  *
  * Copyright (c) 2025 STMicroelectronics.
  * All rights reserved.
  *
  * This software is licensed under terms that can be found in the LICENSE file
  * in the root directory of this software component.
  * If no LICENSE file comes with this software, it is provided AS-IS.
  *
  ******************************************************************************
  */
/* USER CODE END Header */
#include "main.h"

/* USER CODE BEGIN PV */
uint16_t adc_value1, adc_value2;
/* USER CODE END PV */

void SystemClock_Config(void);
/* USER CODE BEGIN PFP */
void ADC_Init(void) {
// 1. Enable clock for GPIOA
RCC->AHB1ENR |= RCC_AHB1ENR_GPIOAEN;

// 2. Configure PA0 and PA1 in analog mode
GPIOA->MODER |= GPIO_MODER_MODER0; // Set PA0 to analog mode (11)
GPIOA->MODER |= GPIO_MODER_MODER1; // Set PA1 to analog mode (11)

// 3. Enable ADC1 clock
RCC->APB2ENR |= RCC_APB2ENR_ADC1EN;

// 4. Configure ADC1
// Disable ADC first
ADC1->CR2 &= ~ADC_CR2_ADON;

// Reset registers
ADC1->CR1 = 0x00000000;
ADC1->CR2 = 0x00000000;

// Configure CR1
// 12-bit resolution (default)
// Scan mode enabled for multiple channels
ADC1->CR1 |= ADC_CR1_SCAN;

// Configure CR2
// Right alignment (default)
// Enable continuous conversion
ADC1->CR2 |= ADC_CR2_CONT;
// External trigger disabled (software trigger)

// Configure number of conversions in regular sequence
ADC1->SQR1 &= ~ADC_SQR1_L; // Clear L[3:0] bits
ADC1->SQR1 |= ((2-1) << 20); // Set L[3:0] to 1 (2 conversions)

// Configure channel sequence
ADC1->SQR3 &= ~(ADC_SQR3_SQ1 | ADC_SQR3_SQ2); // Clear SQ1 and SQ2 bits
ADC1->SQR3 |= (0 << 0); // SQ1 = Channel 0 (PA0)
ADC1->SQR3 |= (1 << 5); // SQ2 = Channel 1 (PA1)

// Configure sampling time for both channels (set to 84 cycles)
ADC1->SMPR2 |= (0x4 << 0); // Channel 0
ADC1->SMPR2 |= (0x4 << 3); // Channel 1

// Enable ADC
ADC1->CR2 |= ADC_CR2_ADON;

// Short delay for ADC to stabilize
for(volatile int i = 0; i < 10000; i++);
}

// Function to start ADC conversion
void ADC_Start(void) {
// Start regular conversion
ADC1->CR2 |= ADC_CR2_SWSTART;
}

// Function to read ADC value
uint16_t ADC_Read(void) {
// Wait for conversion to complete
while(!(ADC1->SR & ADC_SR_EOC));

// Return converted value
return ADC1->DR;
}

//uint32_t value1 = 0;
//uint32_t value2 = 0;
//
//void ADCInit(void) {
//	RCC->APB2ENR |= (1U << 8);
//
//	RCC->AHB1ENR |= (1U << 0);
//
//	GPIOA->MODER |= (3U << 0);	// PA0
//	GPIOA->MODER |= (3U << 2);	// PA1
//
////	ADC1->CR1 &= (1U << 24);
////	ADC1->CR1 &= (1U << 25);
//	ADC1->CR1 = 0;
//	ADC1->CR1 |= (1U << 8);	//SCAN mode
//
////	ADC1->CR2 &= (1U << 0);
//	ADC1->CR2 = 0;
//	ADC1->CR2 |= (1U << 1);	//CONT
//
//	ADC1->SQR1 = (1U << 20);	//L[3:0] 0001 - 2 conversions
//
//	ADC1->SQR3 = 0 | (1U << 5);	// CH0 and CH1
//
//	ADC->CCR = 0;
//
//	ADC1->CR2 |= (1U << 8);	//EOCS = 1 which enables EOC at each conversion in a sequence
//
//	ADC1->CR2 = (1U << 0);	//ADC ON
//}
//
//uint32_t ADCRead(void) {
//	ADC1->CR2 |= (1U << 30);	// SWSTART
//
//	while (!(ADC1->SR & (1U << 1)))
//		// EOC
//		;
//
//	return (ADC1->DR);
//}

/* USER CODE END PFP */

int main(void)
{

  /* MCU Configuration--------------------------------------------------------*/

  /* Reset of all peripherals, Initializes the Flash interface and the Systick. */
  HAL_Init();

  /* Configure the system clock */
  SystemClock_Config();

  /* Initialize all configured peripherals */
  /* USER CODE BEGIN 2 */
  ADC_Init();
//  ADCInit();
  /* USER CODE END 2 */

  /* Infinite loop */
  while (1)
  {

    /* USER CODE BEGIN 3 */
	  ADC_Start();

	  // Read first channel (PA0)
	  adc_value1 = ADC_Read();

	  // Second value will be automatically converted due to continuous mode
	  adc_value2 = ADC_Read();

	  // Do something with the values...

	  // Add delay if needed
	  for(volatile int i = 0; i < 10000; i++);

//		ADC1->CR2 |= (1U << 30);	// SWSTART
//
//		while (!(ADC1->SR & (1U << 1)))
//			// EOC
//			;
//		value1 = ADC1->DR;
//
//		HAL_Delay(1000);
//
//		while (!(ADC1->SR & (1U << 1)))
//			// EOC
//			;
//		value2 = ADC1->DR;
//
//		HAL_Delay(1000);
  }
  /* USER CODE END 3 */
}

void SystemClock_Config(void)
{
  RCC_OscInitTypeDef RCC_OscInitStruct = {0};
  RCC_ClkInitTypeDef RCC_ClkInitStruct = {0};

  /** Configure the main internal regulator output voltage
  */
  __HAL_RCC_PWR_CLK_ENABLE();
  __HAL_PWR_VOLTAGESCALING_CONFIG(PWR_REGULATOR_VOLTAGE_SCALE2);

  /** Initializes the RCC Oscillators according to the specified parameters
  * in the RCC_OscInitTypeDef structure.
  */
  RCC_OscInitStruct.OscillatorType = RCC_OSCILLATORTYPE_HSI;
  RCC_OscInitStruct.HSIState = RCC_HSI_ON;
  RCC_OscInitStruct.HSICalibrationValue = RCC_HSICALIBRATION_DEFAULT;
  RCC_OscInitStruct.PLL.PLLState = RCC_PLL_NONE;
  if (HAL_RCC_OscConfig(&RCC_OscInitStruct) != HAL_OK)
  {
    Error_Handler();
  }

  /** Initializes the CPU, AHB and APB buses clocks
  */
  RCC_ClkInitStruct.ClockType = RCC_CLOCKTYPE_HCLK|RCC_CLOCKTYPE_SYSCLK
                              |RCC_CLOCKTYPE_PCLK1|RCC_CLOCKTYPE_PCLK2;
  RCC_ClkInitStruct.SYSCLKSource = RCC_SYSCLKSOURCE_HSI;
  RCC_ClkInitStruct.AHBCLKDivider = RCC_SYSCLK_DIV1;
  RCC_ClkInitStruct.APB1CLKDivider = RCC_HCLK_DIV1;
  RCC_ClkInitStruct.APB2CLKDivider = RCC_HCLK_DIV1;

  if (HAL_RCC_ClockConfig(&RCC_ClkInitStruct, FLASH_LATENCY_0) != HAL_OK)
  {
    Error_Handler();
  }
}

void Error_Handler(void)
{
  __disable_irq();
  while (1)
  {
  }
}
