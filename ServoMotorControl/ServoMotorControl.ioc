# file: ServoMotorControl.ioc
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Mcu.Family=STM32F4
Mcu.Name=STM32F401R(B-C)Tx
Mcu.Package=LQFP64
NVIC.PriorityGroup=NVIC_PRIORITYGROUP_4
ProjectManager.HeapSize=0x200
ProjectManager.StackSize=0x400
ProjectManager.TargetToolchain=STM32CubeIDE
RCC.48MHZClocksFreq_Value=42000000
RCC.AHBFreq_Value=84000000
RCC.APB1CLKDivider=RCC_HCLK_DIV2
RCC.APB1Freq_Value=42000000
RCC.APB1TimFreq_Value=84000000
RCC.APB2Freq_Value=84000000
RCC.APB2TimFreq_Value=84000000
RCC.CortexFreq_Value=84000000
RCC.HCLKFreq_Value=84000000
RCC.HSE_VALUE=25000000
RCC.HSI_VALUE=16000000
RCC.LSE_VALUE=32768
RCC.PLLM=8
RCC.PLLN=84
RCC.SYSCLKFreq_VALUE=84000000
RCC.SYSCLKSource=RCC_SYSCLKSOURCE_PLLCLK
RCC.VCOOutputFreq_Value=168000000
board=custom

// file: Core/Src/main.c
/* USER CODE BEGIN Header */
/**
  ******************************************************************************
  * @file           : main.c
  * @brief          : Main program body
  ******************************************************************************
  * @attention
  *
  * Copyright (c) 2025 STMicroelectronics.
  * All rights reserved.
  *
  * This software is licensed under terms that can be found in the LICENSE file
  * in the root directory of this software component.
  * If no LICENSE file comes with this software, it is provided AS-IS.
  *
  ******************************************************************************
  */
/* USER CODE END Header */
#include "main.h"

void SystemClock_Config(void);
/* USER CODE BEGIN PFP */
void GPIO_PB6_Init(void);
void TIM4_Init(void);
void Set_Servo_Angle(uint16_t angle);
/* USER CODE END PFP */

int main(void)
{

  /* MCU Configuration--------------------------------------------------------*/

  /* Reset of all peripherals, Initializes the Flash interface and the Systick. */
  HAL_Init();

  /* Configure the system clock */
  SystemClock_Config();

  /* Initialize all configured peripherals */
  /* USER CODE BEGIN 2 */
  GPIO_PB6_Init();

  // Initialize TIM3 for PWM generation
  TIM4_Init();
  /* USER CODE END 2 */
  TIM4->CCR1 = 1000; //1 ms
//  TIM4->CCR1 = 210; //2 ms
  HAL_Delay(1000);
  /* Infinite loop */
  while (1)
  {

    /* USER CODE BEGIN 3 */
	// Set servo angle to 0 degrees (1 ms pulse width)
//	Set_Servo_Angle(0);
//	HAL_Delay(1000);
//
//	// Set servo angle to 90 degrees (1.5 ms pulse width)
//	Set_Servo_Angle(90);
//	HAL_Delay(1000);
//
//	// Set servo angle to 180 degrees (2 ms pulse width)
//	Set_Servo_Angle(180);
//	HAL_Delay(1000);
//	  for(int i = 1000; i <= 2000; i++)
//	  {
//		  TIM4->CCR1 = i;
//		  HAL_Delay(50);
//	  }
//	  for(int i = 2000; i >= 1000; i--)
//	  {
//		  TIM4->CCR1 = i;
//		  HAL_Delay(50);
//	  }

	  TIM4->CCR1 = 1000;
	  HAL_Delay(1000);

	  TIM4->CCR1 = 1500;
	  HAL_Delay(1000);

	  TIM4->CCR1 = 2500;
	  HAL_Delay(1000);
  }
  /* USER CODE END 3 */
}

void SystemClock_Config(void)
{
  RCC_OscInitTypeDef RCC_OscInitStruct = {0};
  RCC_ClkInitTypeDef RCC_ClkInitStruct = {0};

  /** Configure the main internal regulator output voltage
  */
  __HAL_RCC_PWR_CLK_ENABLE();
  __HAL_PWR_VOLTAGESCALING_CONFIG(PWR_REGULATOR_VOLTAGE_SCALE2);

  /** Initializes the RCC Oscillators according to the specified parameters
  * in the RCC_OscInitTypeDef structure.
  */
  RCC_OscInitStruct.OscillatorType = RCC_OSCILLATORTYPE_HSI;
  RCC_OscInitStruct.HSIState = RCC_HSI_ON;
  RCC_OscInitStruct.HSICalibrationValue = RCC_HSICALIBRATION_DEFAULT;
  RCC_OscInitStruct.PLL.PLLState = RCC_PLL_ON;
  RCC_OscInitStruct.PLL.PLLSource = RCC_PLLSOURCE_HSI;
  RCC_OscInitStruct.PLL.PLLM = 8;
  RCC_OscInitStruct.PLL.PLLN = 84;
  RCC_OscInitStruct.PLL.PLLP = RCC_PLLP_DIV2;
  RCC_OscInitStruct.PLL.PLLQ = 4;
  if (HAL_RCC_OscConfig(&RCC_OscInitStruct) != HAL_OK)
  {
    Error_Handler();
  }

  /** Initializes the CPU, AHB and APB buses clocks
  */
  RCC_ClkInitStruct.ClockType = RCC_CLOCKTYPE_HCLK|RCC_CLOCKTYPE_SYSCLK
                              |RCC_CLOCKTYPE_PCLK1|RCC_CLOCKTYPE_PCLK2;
  RCC_ClkInitStruct.SYSCLKSource = RCC_SYSCLKSOURCE_PLLCLK;
  RCC_ClkInitStruct.AHBCLKDivider = RCC_SYSCLK_DIV1;
  RCC_ClkInitStruct.APB1CLKDivider = RCC_HCLK_DIV2;
  RCC_ClkInitStruct.APB2CLKDivider = RCC_HCLK_DIV1;

  if (HAL_RCC_ClockConfig(&RCC_ClkInitStruct, FLASH_LATENCY_2) != HAL_OK)
  {
    Error_Handler();
  }
}

/* USER CODE BEGIN 4 */
void GPIO_PB6_Init(void) {
    // Enable GPIOB clock
    RCC->AHB1ENR |= RCC_AHB1ENR_GPIOBEN;

    // Set PB6 as alternate function (PWM output)
    GPIOB->MODER &= ~GPIO_MODER_MODE6;
    GPIOB->MODER |= GPIO_MODER_MODE6_1;  // Alternate function mode
    GPIOB->AFR[0] |= (0x2 << (6 * 4));   // AF2 (TIM4_CH1)
}
void TIM4_Init(void) {
    // Enable TIM4 clock
    RCC->APB1ENR |= RCC_APB1ENR_TIM4EN;

    // Set prescaler and auto-reload for 50 Hz frequency (20 ms period)
    TIM4->PSC = 84;  // Prescaler to divide 84 MHz by 840 (100 kHz timer clock)
    TIM4->ARR = 20000-1; // Auto-reload value for 50 Hz (100 kHz / 50 Hz - 1)

    // Set pulse width for 0 degrees (1 ms)
    TIM4->CCR1 = 99;  // 1 ms pulse width at 50 Hz

    // Configure PWM mode for OC1 (PWM Mode 1)
    TIM4->CCMR1 &= ~TIM_CCMR1_OC1M; // Clear previous settings
    TIM4->CCMR1 |= (0x6 << TIM_CCMR1_OC1M_Pos); // Set PWM Mode 1 for OC1

    // Enable PWM output on TIM4_CH1
    TIM4->CCER |= TIM_CCER_CC1E;          // Enable output

    // Start the timer
    TIM4->CR1 |= TIM_CR1_CEN;
}

void Set_Servo_Angle(uint16_t angle) {
    // Calculate pulse width based on angle (1 ms for 0°, 1.5 ms for 90°, 2 ms for 180°)
    uint16_t pulseWidth = (angle * 1000 / 180) + 100; // Pulse width = (angle / 180) * 1 ms + 1 ms

    // Set the compare register for TIM4
    TIM4->CCR1 = pulseWidth;
}
/* USER CODE END 4 */

void Error_Handler(void)
{
  __disable_irq();
  while (1)
  {
  }
}
